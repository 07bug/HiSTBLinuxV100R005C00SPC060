## scripts/kconfig/Kconfig.ci
```kconfig
menu "CI Config"
    depends on HI3796MV200 || HI3716MV450

menuconfig HI_CI_SUPPORT
    bool "CI Support"
    help
        when enabled, CI is supported. CI(Common Interface) is used by chipset to communicate with CAM card
    depends on HI3796MV200 || HI3716MV450
    default n

choice
    prompt "Device type"
    depends on HI_CI_SUPPORT
    default HI_CI_DEV_HICI

config HI_CI_DEV_HICI
    bool "HICI"
    help
        when enabled, HICI is supported, HICI is an internal module of chipset to support Common Interface (CI)

endchoice

endmenu
```

## scripts/kconfig/Kconfig.crypto
```kconfig
menu "Crypto Config"

config HI_PLCIPHER_SUPPORT
    bool "PLCipher support"
    help
        PLCipher is used to decrypt ts packages in payload mode and then generate clear ts packages
    depends on HI3796MV200 || HI3716MV450 || ((HI3716MV410 || HI3716MV420) && ADVCA_NAGRA)
    default y

config HI_OPENSSL_SUPPORT
    bool "Openssl Support"
    depends on LINUX_PRODUCT
    default n

endmenu
```

## scripts/kconfig/Kconfig.curl
```kconfig
config HI_CURL_SUPPORT
    bool "Curl Support"
    depends on HI_APPLOADER_MODE_IP || HI_PLAYER_SUPPORT
    default n
    help
      If you wan't to support curl, say y here.
```

## scripts/kconfig/Kconfig.debug
```kconfig
menu "Debug Config"

config HI_LOG_SUPPORT
    bool "Log Support"
    help
        this flag is used to enable/disable debug messages of some specific modules, see detail inside 
    default n if FUNCTION_RELEASE
    default y

choice
    prompt "Log Level"
    default HI_LOG_LEVEL_DEBUG
    depends on HI_LOG_SUPPORT

config HI_LOG_LEVEL_FATAL
    bool "FATAL"
config HI_LOG_LEVEL_ERROR
    bool "ERROR"
config HI_LOG_LEVEL_WARNING
    bool "WARNING"
config HI_LOG_LEVEL_INFO
    bool "INFO"
config HI_LOG_LEVEL_DEBUG
    bool "DEBUG"
endchoice

config HI_LOG_LEVEL
    int
    depends on HI_LOG_SUPPORT
    default 0       if HI_LOG_LEVEL_FATAL
    default 1       if HI_LOG_LEVEL_ERROR
    default 2       if HI_LOG_LEVEL_WARNING
    default 3       if HI_LOG_LEVEL_INFO
    default 4       if HI_LOG_LEVEL_DEBUG

config HI_LOG_NETWORK_SUPPORT
    bool "Network Log Support"
    default n
    depends on HI_LOG_SUPPORT
    help
        This option controls the network log output, disabled by default.

config HI_LOG_UDISK_SUPPORT
    bool "UDisk Log Support"
    default n
    depends on HI_LOG_SUPPORT
    help
        This option controls the u-disk log, disabled by default.
        when enabled, the log will be written into u-disk.

config HI_PROC_SUPPORT
    bool "Proc Support"
    default n if FUNCTION_RELEASE
    default y
    help
        when enabled, proc system is supported.
        this is not allowed in some specific security (CAS) release case, enabled by default.

config HI_PROC_WRITE_SUPPORT
    bool "Proc Write Support"
    help
        when enabled, the proc system have write-permission.
    depends on HI_PROC_SUPPORT
    default n if FUNCTION_RELEASE
    default y

endmenu
```

## scripts/kconfig/Kconfig.demux
```kconfig
menu "Demux Config"
    depends on !HI_NVR_SUPPORT

config HI_DEMUX_SUPPORT
    bool
    default y

config HI_DEMUX_POOLBUF_SIZE
    hex "Poolbuf Size"
    depends on HI_DEMUX_SUPPORT
    default 0x200000
    help
        set buffer size of section, pes and post channel.

config HI_DMX_TSBUF_MULTI_THREAD_SUPPORT
    bool "Support multithread operate one ts buffer"
    depends on HI_DEMUX_SUPPORT
    default n
    help
        when enabled, HI_UNF_DMX_GetTSBuffer() and HI_UNF_DMX_PutTSBuffer() will be disabled
        when enabled, HI_UNF_DMX_AcquireTSBuffer(), HI_UNF_DMX_PushTSBuffer() and HI_UNF_DMX_ReleaseTSBuffer() will be enabled.

config HI_DEMUX_INVALID_PES_DROP_SUPPORT
    bool "Support drop invalid audio pes package"
    depends on HI_DEMUX_SUPPORT &&  ADVCA_IRDETO
    default n
    help
       when enabled, invalid pes packages will be dropped

config HI_DMX_DUP_PID_CHANNEL_SUPPORT
    bool "Support pid copy"
    depends on (HI_DEMUX_SUPPORT && (HI3796MV200 || HI3716MV450 || HI3798CV200 || HI3798MV200 || HI3798MV300 || HI3798MV300H || HI3798MV310))
    default n if (HI3796MV200 || HI3716MV450 || HI3798MV200 || HI3798MV300 || HI3798MV300H || HI3798MV310)
    default y if HI3798CV200
    help
        when enabled, Support pid copy
endmenu
```

## scripts/kconfig/Kconfig.drm
```kconfig
menuconfig HI_DRM_SUPPORT
    bool "DRM Support"
    help
        when enabled, Digital Right Management(DRM) is supported, such as Playready, Widevine.
    default n

config SINGLE_PROCESS_ENABLE
    bool "DRM Single Process"
    help
        when enabled, player and drm framwork will run in one process, not Client-Server (multiple processes) architecture.
    depends on (HI_DRM_SUPPORT && LINUX_PRODUCT)
    default n

config HI_PLAYREADY_SUPPORT
    bool "PlayReady Support"
    depends on HI_DRM_SUPPORT && LINUX_PRODUCT && (HI3798CV200 || HI3798MV200 || HI3798MV300 || HI3798MV300H || HI3798MV310 || HI3796MV200 || HI3716MV450 || HI3716MV410 || HI3716MV420)
    default n

choice
    prompt "PlayReady Type"
    default HI_PLAYREADY_3_0
    depends on HI_PLAYREADY_SUPPORT

config  HI_PLAYREADY_2_0
    bool "PlayReady 2.0"
    depends on ANDROID_PRODUCT

config  HI_PLAYREADY_3_0
    bool "PlayReady 3.0"
    depends on (HI3798CV200 || HI3798MV200 || HI3798MV300 || HI3798MV300H || HI3798MV310 || HI3796MV200 || HI3716MV450)

endchoice

config HI_WIDEVINE_SUPPORT
    bool "Widevine Support"
    depends on HI_DRM_SUPPORT && LINUX_PRODUCT && (HI3798CV200 || HI3798MV200 || HI3798MV300 || HI3798MV300H || HI3798MV310 || HI3796MV200 || HI3716MV450 || HI3796MV100 || HI3798MV100)
    default n

choice
    prompt "Widevine Type"
    default HI_WIDEVINE_L1
    depends on HI_WIDEVINE_SUPPORT

config  HI_WIDEVINE_L1
    bool "Widevine L1"
    depends on (HI3798CV200 || HI3798MV200 || HI3798MV300 || HI3798MV300H || HI3798MV310 || HI3796MV200 || HI3716MV450 || HI3798MV100 || HI3796MV100)

endchoice

config HI_MARLIN_SUPPORT
    bool "Marlin Support"
    depends on HI_DRM_SUPPORT && LINUX_PRODUCT && (HI3798CV200 || HI3798MV200 || HI3796MV200)
    default n

choice
    prompt "Marlin Type"
    default HI_MARLIN_BBTS
    depends on HI_MARLIN_SUPPORT

config  HI_MARLIN_BBTS
    bool "Marlin BBTS"
    depends on (HI3798CV200 || HI3798MV200 || HI3796MV200)

endchoice
```

## scripts/kconfig/Kconfig.env.media
```kconfig
choice
    prompt "Media Type"
    depends on HI_FORCE_ENV_TO_MEDIA

config FORCE_ENV_IN_NAND
    bool "Nand"
    help
        the bootargs is forced to be set to NAND flash

config FORCE_ENV_IN_SPI
    bool "SPI_Flash"
    help
        the bootargs is forced to be set to SPI flash

config FORCE_ENV_IN_EMMC
    bool "eMMC"
    help
        the bootargs is forced to be set to dMMC flash

endchoice
```

## scripts/kconfig/Kconfig.filesystem
```kconfig
menu "Busybox Config"

config  HI_BUSYBOX_CFG_NAME
    string "Busybox Config File For Root"
    default glibc.config
    help
      Input config file for root busybox. Such as xxxxx.config.
      Config files are located in busybox source: busybox-1.*.1.config/

config  HI_BUSYBOX_CFG_SANDBOX_NAME
    string "Busybox Config File For Sandbox User"
    default glibc_ca_sandbox.config
    depends on HI_ADVCA_SANDBOX_SUPPORT
    help
      Input config file for sandbox user busybox. Such as xxxxx.config.
      Config files are located in busybox source: busybox-1.*.1.config/

endmenu

config HI_LIBCPP_SUPPORT
    bool "C++ Runtime Libarary Support"
    default y
    help
      If you need use C++ libarary, say y here.

config HI_ROOTFS_STRIP
    bool "Enable Strip"
    default y
    help
      Whether strip the root filesystem.
      If you select strip option, you will get fail when use gdb, because the clib is striped.
           y - strip /bin /lib /sbin /usr
           n - not strip

config HI_ROOTFS_INSTALL_SHARED_LIBS
    bool "Install Share Libs to Rootfs"
    default y

config HI_ROOTFS_CRAMFS
    bool "Create Cramfs Rootfs Image"
    default y

config HI_ROOTFS_JFFS2
    bool "Create Jffs2 Rootfs Image"
    depends on HI_SPI_SUPPORT
    default y

config HI_ROOTFS_YAFFS
    bool "Create Yaffs Rootfs Image"
    depends on HI_NAND_SUPPORT || HI_SPI_NAND_SUPPORT
    default y

config HI_ROOTFS_SQUASHFS
    bool "Create Squashfs Rootfs Image"
    default y

config HI_ROOTFS_EXT4
    bool "Create ext4 Rootfs Image"
    depends on HI_EMMC_SUPPORT
    default n

config HI_EMMC_ROOTFS_SIZE
    int "eMMC Rootfs Size"
    depends on HI_ROOTFS_EXT4
    default "96"
    help
      eMMC rootfs size, unit is M.

config HI_ROOTFS_UBIIMG
    bool "Create Ubi Rootfs Image"
    depends on HI_NAND_SUPPORT
    default y

config HI_UBI_PARTITION_SIZE
    string "UBI Rootfs Size"
    depends on HI_ROOTFS_UBIIMG
    default "96M"

config HI_DATA_UBI_PARTITION_SIZE
    string "Data Partition UBI Rootfs Size"
    depends on HI_ROOTFS_UBIIMG && (HI3796MV200 || HI3716MV450 || HI3716MV410 || HI3716MV420)
    default "32M"

config HI_TRUSTED_STORAGE_UBI_PARTITION_SIZE
    string "Trusted Storage Partition UBI Rootfs Size"
    depends on HI_ROOTFS_UBIIMG && HI3796MV200
    default "32M"
```

## scripts/kconfig/Kconfig.flash
```kconfig
#+++++++++++++++++++++++++++++++++++++++++++++++++++
menu "Flash Config"
#--------------------------------
menuconfig HI_NAND_FLASH_SUPPORT
    bool "Nand Flash support"

menu   "Nand Flash device support"
    depends on HI_NAND_FLASH_SUPPORT

config HI_NAND_SUPPORT
    bool "Nand Flash Support"
config HI_SPI_NAND_SUPPORT
    bool "Spi-Nand Flash Support"
endmenu

config  HI_NAND_BLOCK_SIZE
    hex "Block Size"
    depends on HI_NAND_SUPPORT || HI_SPI_NAND_SUPPORT
    default 0x20000
    help
      set Nand flash block size.

config  HI_NAND_PAGE_SIZE
    string "Page Size"
    depends on HI_NAND_SUPPORT || HI_SPI_NAND_SUPPORT
    default 2k
    help
      set Nand flash page size, such as 2k,4k,8k.

config  HI_NAND_ECC_TYPE
    string "ECC Type"
    depends on HI_NAND_SUPPORT || HI_SPI_NAND_SUPPORT
    default 1bit
    help
      set Nand flash chip ECC type, such as 1bit,4bit,8bit,24bit,40bit.

config  HI_MFTL_SUPPORT
    bool "MFTL NAND Support"
    depends on HI_NAND_SUPPORT
    default n
    help
      Say y here to enable Micron MLC FTL NAND support.

#--------------------------------
menuconfig HI_SPI_SUPPORT
    bool "SPI Flash Support"
    depends on !(HI3798MV100 || HI3796MV100)
    default y
    help

config  HI_SPI_BLOCK_SIZE
    hex "Block Size"
    depends on HI_SPI_SUPPORT
    default 0x10000
    help
      set SPI flash block size.

#--------------------------------

config HI_EMMC_SUPPORT
    bool "eMMC Flash Support"
    depends on !HI3716MV410
    default n
    help
      Say y here to enables emmc flash support.
#+++++++++++++++++++++++++++++++++++++++++++++++++++
endmenu
```

## scripts/kconfig/Kconfig.gpioi2c
```kconfig
#+++++++++++++++++++++++++++++++++++++
#menu "gpio simulate i2c support config"
#+++++++++++++++++++++++++++++++++++++

config HI_GPIOI2C_SUPPORT
    bool "Gpio Simulate I2c Support"
    help
        when enabled, GPIO can be used to simulate I2C
    default y

#+++++++++++++++++++++++++++++++++++++
#endmenu
#+++++++++++++++++++++++++++++++++++++
```

## scripts/kconfig/Kconfig.gpu
```kconfig
#+++++++++++++++++++++++++++++++++++++++++++++++++++
menu "GPU Config"

config HI_GPU_SUPPORT
    tristate "GPU Support"
    ---help---
      when enabled, GPU is supported

config HI_GPU_MALI400_SUPPORT
    bool
    depends on HI_GPU_SUPPORT && HI3716MV420
    default y

config HI_GPU_MALI450_SUPPORT
    bool
    depends on HI_GPU_SUPPORT && (HI3798MV100 || HI3796MV100 || HI3798MV200 || HI3798MV300 || HI3798MV300H || HI3798MV310 || HI3796MV200 || HI3716MV450)
    default y

config HI_GPU_MALI700_SUPPORT
    bool
    depends on HI_GPU_SUPPORT && HI3798CV200
    default y

config HI_GPU_DEBUG
    bool "Enable debug in Mali driver"
    depends on HI_GPU_SUPPORT
    help
        enable extra debug messages in the Mali driver.

choice
    prompt "EGL Native Window System Config"
    depends on HI_GPU_SUPPORT
    default EGL_FB
config  EGL_FB
    bool "FB"
config  EGL_DFB
    bool "DirectFB"
endchoice

config  HI_EGL_TYPE
    depends on HI_GPU_SUPPORT
    string
    default fb   if EGL_FB
    default directfb if EGL_DFB

endmenu
#+++++++++++++++++++++++++++++++++++++++++++++++++++
```

## scripts/kconfig/Kconfig.graphics
```kconfig
menu "Graphics Config"

config HI_HIGO_SUPPORT
    bool "HIGO Support"
    default y
    depends on LINUX_PRODUCT
    help
        The HiGo is a highly efficient graphics component provided by HiSilicon.
        It makes full use of the acceleration function of chips and provides the basic
        functions required for graphical user interface (GUI) development.

config  HIFB_SCROLLTEXT_SUPPORT
    bool "Scrolltext Support"
    default n
    depends on HI_HIGO_SUPPORT

menuconfig HI_DIRECTFB_SUPPORT
    bool "DirectFB Support"
    default n
    depends on LINUX_PRODUCT

config HI_DIRECTFB_MULTI_SUPPORT
    bool "DirectFB Multi Process support"
    default n
    depends on HI_DIRECTFB_SUPPORT

config HI_DIRECTFB_DEBUG_SUPPORT
    bool "DirectFB Debug support"
    help
        enabled debug messages for development
    default n
    depends on HI_DIRECTFB_SUPPORT

config HI_DIRECTFB_CA_SUPPORT
    bool "DirectFB CA Support"
    help
        when enabled, DirectFB module is enhanced only in some specific security cases
    default n
    depends on HI_DIRECTFB_SUPPORT && HI_ADVCA_SUPPORT

config HI_GFX2D_SUPPORT
    bool "GFX2D Support"
    help
        GFX2D module is used for 2D graphics accelerating
    default y
    depends on ANDROID_PRODUCT && (HI3798CV200 || HI3798MV200 || HI3798MV300 || HI3798MV300H || HI3798MV310 || HI3796MV200 || HI3716MV450)

config HI_FB0_SMMU_SUPPORT
    bool
    default n
    depends on HI_SMMU_SUPPORT

config HI_FB1_SMMU_SUPPORT
    bool
    default y
    depends on HI_SMMU_SUPPORT

config HI_FB2_SMMU_SUPPORT
    bool
    default y
    depends on HI_SMMU_SUPPORT

#config  HIFB_CURSOR_SUPPORT
#    bool "Cursor in FB Support"
#    default n

config  HI_FB_DECOMPRESS_SUPPORT
    bool "DeCompress in FB Support"
    default y
    depends on HI_GFX2D_SUPPORT
    depends on HI3798CV200 || HI3798MV300 || HI3798MV300H || HI3798MV310 || HI3798MV200 || HI3796MV200 || HI3716MV450

config  HI_HD0_FB_VRAM_SIZE
    int "KB, HD0 FrameBuffer Size"
    default 7200
    help
        set the HD0 FrameBuffer Size, for example:
            for 1280*720, double buffer, ARGB8888 format, the size is calculated as below:
            (1280*720*4*2/1024)KB

config  HI_HD1_FB_VRAM_SIZE
    int "KB, HD1 FrameBuffer Size"
    default 0
    help
        set the HD1 FrameBuffer Size, for example:
            for 1280*720, double buffer, ARGB8888 format, the size is calculated as below:
            (1280*720*4*2/1024)KB

config  HI_HD2_FB_VRAM_SIZE
    int "KB, HD2 FrameBuffer Size"
    default 0
    help
        set the HD2 FrameBuffer Size, for example:
            for 1280*720, double buffer, ARGB8888 format, the size is calculated as below:
            (1280*720*4*2/1024)KB

endmenu
#+++++++++++++++++++++++++++++++++++++++++++++++++++
```

## scripts/kconfig/Kconfig.gstreamer
```kconfig
#+++++++++++++++++++++++++++++++++++++++++++++++++++
config GSTREAMER_SUPPORT
    bool "Gstreamer Support"
    depends on HI3798MV200
    select HI_OMX_SUPPORT
    default n
    help
      If you want to choose Gstreamer support in SDK, Select this option.
      It will select omx audio support automatically.

#config  GSTREAMER_FULL_SUPPORT
#   bool "Gstreamer Full Support"
#   depends on GSTREAMER_SUPPORT
#   default n
#+++++++++++++++++++++++++++++++++++++++++++++++++++
```
