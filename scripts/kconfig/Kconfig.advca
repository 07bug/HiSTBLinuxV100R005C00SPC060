## scripts/kconfig/Kconfig.advca
```kconfig
#+++++++++++++++++++++++++++++++++++++++++++++++++++
menuconfig HI_ADVCA_SUPPORT
    bool "Advance CA Support"
    help
        enable this item only for security cases which have been listed inside, make sure select the correct 'Advanced CA Type'

    default n
#--------------------------------
choice
    prompt "Advance CA Type"
    depends on HI_ADVCA_SUPPORT
    default ADVCA_OTHER
config  ADVCA_CONAX
    bool "Conax"
    help
        enable this item only for 'Conax' security case

config  ADVCA_NOVEL
    bool "Novel"
    help
        enable this item only for 'Novel' security case

config  ADVCA_NAGRA
    bool "Nagra"
    help
        enable this item only for 'Nagra' security case
    select HI_TSIO_SUPPORT if (HI3796MV200 || HI3716MV450)

config  ADVCA_SUMA
    bool "Suma"
    help
        enable this item only for 'Suma' security case

config  ADVCA_CTI
    bool "Cti"
    help
        enable this item only for 'Cti' security case

config  ADVCA_VERIMATRIX
    bool "Verimatrix"
    help
        enable this item only for 'Verimatrix' security case, please select either "Advanced" or "Ultra" in 'Verimatrix Type' menu

config  ADVCA_IRDETO
    bool "Irdeto"
    help
        enable this item only for 'Irdeto' security case

config  ADVCA_PANACCESS
    bool "Panaccess"
    help
        enable this item only for 'Panaccess' security case

config  ADVCA_DCAS
    bool "Dcas"
    help
        enable this item only for 'DCAS' security case

config  ADVCA_L2
    bool "L2"
    help
        enable this item only for 'L2' security cases
config  ADVCA_OTHER
    bool "Other"
    help
        enable this item only for other security cases, which are not defined to some specific CA types, therefore please connect Hisilicon if you don't know how to config the 'Advanced CA Type' menu

endchoice

choice
    prompt "Verimatrix Type"
    depends on  ADVCA_VERIMATRIX && HI_ADVCA_SUPPORT
config  ADVCA_VERIMATRIX_ADVANCE
    bool "Advanced"
    help
        select this item only for 'Verimatrix Advanced' security case

config  ADVCA_VERIMATRIX_ULTRA
    bool "Ultra"
    help
        select this item only for 'Verimatrix Ultra' security case

endchoice

choice
    prompt "Conax Product Category"
    help
        there are four Conax product categories: Smartcard | Core_Access | Lynx | Prime_Access, STBM should select one
    depends on ADVCA_CONAX && HI_ADVCA_SUPPORT  && !(HI3716MV410 || HI3716MV420)

config  CX_SMARTCARD
    bool "Smartcard"
    help
        chipset pairing with smartcard, for non-TEE system

config  CX_CORE_ACCESS
    bool "Core_Access"
    help
        cardless, for non-TEE system

config  CX_LYNX
    bool "Lynx"
    help
        card-based, for TEE system

config  CX_PRIME_ACCESS
    bool "Prime_Access"
    help
        cardless, for TEE system

endchoice

config HI_DRV_WORK_IN_NON_SECURE_MODE
    bool "Drivers Work In Non Secure Mode"
    default n
    depends on (HI3798MV200 || HI3798CV200) && ADVCA_VERIMATRIX_ULTRA && ADVCA_VERIMATRIX && HI_ADVCA_SUPPORT
    help
        keyladder operations will be allowed in loader system, currently this flag is only valid for Verimatrix Ultra case.

menu "FBL Parameters Config"
    depends on HI3798MV200 && ADVCA_VERIMATRIX_ULTRA && ADVCA_VERIMATRIX && HI_ADVCA_SUPPORT

config HI_FBL_OEM_RSA_PUB_KEY
    prompt "OEM RSA Public key(512 Bytes)"
    string
    depends on ADVCA_VERIMATRIX_ULTRA && ADVCA_VERIMATRIX && HI_ADVCA_SUPPORT
    help
        this pub key is generated by STBM, it's used to verify the signature of SBL image and signature of "Ext Params Area" in FBL image

config HI_FBL_SWPK_OEM_KEY
    prompt "Encrypted SWPK_OEM(16 bytes)"
    string
    depends on ADVCA_VERIMATRIX_ULTRA && ADVCA_VERIMATRIX && HI_ADVCA_SUPPORT
    help
        this key is generated by STBM, it's used to decrypt SBL image

config HI_FBL_PARITITION_SIZE
    hex "FBL paritition size"
    depends on ADVCA_VERIMATRIX_ULTRA && ADVCA_VERIMATRIX && HI_ADVCA_SUPPORT
    help
        set the size of 'fastboot' (we call it as FBL) partition
    default 0x100000

config HI_SECURE_OS_PARITITION_SIZE
    hex "Secure OS paritition size"
    depends on ADVCA_VERIMATRIX_ULTRA && ADVCA_VERIMATRIX && HI_ADVCA_SUPPORT
    help
        set the size of 'SOS' partition
    default 0x800000

config HI_SBL_PARITITION_SIZE
    hex "SBL paritition size"
    depends on ADVCA_VERIMATRIX_ULTRA && ADVCA_VERIMATRIX && HI_ADVCA_SUPPORT
    help
        set the size of 'SBL' partition
    default 0x400000

config HI_FBL_DATA_PARITITION_SIZE
    hex "FBL data paritition size"
    depends on ADVCA_VERIMATRIX_ULTRA && ADVCA_VERIMATRIX && HI_ADVCA_SUPPORT
    help
        set the size of 'fbldata' partition
    default 0x800000

config HI_SBL_VERIFY_FLAG
    bool "SBL Verify Flag"
    depends on ADVCA_VERIMATRIX_ULTRA && ADVCA_VERIMATRIX && HI_ADVCA_SUPPORT
    default n
    help
        if the SBL image is signed and its signature should be verified first before start, say y, if the signature of SBL image is not need to be verified, say n.

config HI_SBL_DECRYPT_FLAG
    bool "SBL Decrypt Flag"
    depends on ADVCA_VERIMATRIX_ULTRA && ADVCA_VERIMATRIX && HI_ADVCA_SUPPORT && (HI_SBL_VERIFY_FLAG=y)
    default n
    help
        if the SBL image is not encrypted, say n; if SBL image is encrypted, say y. note that this flag is only valid when HI_SBL_VERIFY_FLAG is y.
endmenu

config  HI_ADVCA_TYPE
    string
    depends on HI_ADVCA_SUPPORT
    default CONAX           if ADVCA_CONAX
    default NOVEL           if ADVCA_NOVEL
    default NAGRA           if ADVCA_NAGRA
    default SUMA            if ADVCA_SUMA
    default CTI             if ADVCA_CTI
    default VERIMATRIX      if ADVCA_VERIMATRIX_ADVANCE
    default VERIMATRIX_ULTRA     if ADVCA_VERIMATRIX_ULTRA
    default IRDETO      if ADVCA_IRDETO
    default PANACCESS   if ADVCA_PANACCESS
    default DCAS        if ADVCA_DCAS
    default L2          if ADVCA_L2
    default OTHER           if ADVCA_OTHER
    
config  HI_CX_PRODUCT_TYPE
    string
    depends on HI_ADVCA_SUPPORT
    default SMARTCARD      if CX_SMARTCARD
    default CORE_ACCESS    if CX_CORE_ACCESS
    default LYNX           if CX_LYNX
    default PRIME_ACCESS   if CX_PRIME_ACCESS

#--------------------------------

menuconfig ADVCA_FUNCTION
    bool "Advance CA Function"
    depends on HI_ADVCA_SUPPORT
    default n
    help
        this option is only valid for Nagra and Conax security case, some functions of SDK will be enabled or disabled depending on the this flag, see more detail inside.

choice
    prompt "Advca Function"
    depends on ADVCA_FUNCTION
config  FUNCTION_RELEASE
    bool "RELEASE"
    help
        when this option is selected, SDK can meet some security requirements listed below.
            1.Useless drivers,modules and libraries are not allowed to be compiled.
            2.Modules in kernel are not unloadable.
            3.NFS is not supported.
            4.No debugging method is supported.No debugging information outputs.
            5.No user can log into system through shell.

config  FUNCTION_DEBUG
    bool "DEBUG"
    help
        when this option is selected, functions below are added to FINAL version.
            1.Allow communication through UART.
            2.Allow user to log into system.
            3.Allow user to run apps in command line.

endchoice

config  HI_ADVCA_FUNCTION
    string
    depends on ADVCA_FUNCTION
    default DEBUG       if FUNCTION_DEBUG
    default RELEASE     if FUNCTION_RELEASE

config HI_STATIC_LIB_ONLY
    bool
    help
        when enabled, the application can only link static libraries

    default y
    depends on ADVCA_FUNCTION

config HI_LOAD_CAS_IMAGE
    bool
    depends on (HI3796MV200 || HI3716MV450) && (HI_ADVCA_SUPPORT) && ((ADVCA_CONAX && (CX_CORE_ACCESS || CX_PRIME_ACCESS)) || ADVCA_IRDETO)
    help
        when enabled, the system supports loading CAS Image (for Conax) or CAS loader (for Irdeto) for cardless solution
    default y

config HI_ADVCA_VERIFY_ENABLE
    bool "Advca Verify Enable"
    depends on HI_ADVCA_SUPPORT
    help
        when enabled, the non-boot images (such as bootargs, kernel and so on) will be verified by boot image before they are started.

menuconfig HI_ADVCA_RUNTIME_CHECK_ENABLE
    bool "Runtime check enable"
    depends on (HI_ADVCA_SUPPORT) && (ADVCA_CONAX || ADVCA_IRDETO)
    default y
    help
        enable runtime check feature, please make sure runtime check related otp fuses have been set correctly in advance.

config HI_ROOTFS_RUNTIME_CHECK_ENABLE
    bool "Rootfs runtime check enable"
    depends on (HI_ADVCA_RUNTIME_CHECK_ENABLE) && (HI3796MV200 || HI3716MV450)
    default y
    help
      If you want to disable rootfs runtime check longly, say n.

config HI_ROOTFS_CALCULATE_DELAY_TIME
    int "Rootfs calculate delay time"
    depends on HI_ROOTFS_RUNTIME_CHECK_ENABLE
    default 100
    help
         this is for the delay time between the new caculation of rootfs. The unit is ms.

config HI_ADVCA_VMX_3RD_SIGN
    bool "Verimatrix Third-Party Sign Solution"
    depends on (HI_ADVCA_SUPPORT && ADVCA_VERIMATRIX_ADVANCE)
    default n
    help
        enable verimatrix advanced third-party signing solution. In this case, Verimatrix will only sign the 'keyarea' of boot image, all following images (including non-boot images) can be signed and verified by STBM itself, see more detail in document <Verimatrix Advanced Development Guide>

config HI_ADVCA_VMX_3RD_SIGN_ENCRYPT_ENABLE
    bool "Verimatrix Third-Party Encrypt Enable"
    depends on(HI_ADVCA_VMX_3RD_SIGN)
    default y
    help
        enable encrypt the images in verimatrix advanced third-party signing solution. In this case, images will be encrypt witch blpk(swpk).

config HI_ADVCA_USE_EXT1_RSA_KEY
    bool "Verify with ext1_rsa_key"
    depends on HI_ADVCA_SUPPORT && ADVCA_CONAX
    default n
    help
        If the boot verify other images (kernel,loader,rootfs and so on) with the ext1_rsa_key which is stored in the key area of signed boot image, say y.
        If this option is not selected, the boot will verify other images with the ext2_rsa_key which is hardcoded in bootcode.
        Please refer to source/boot/product/driver/advca/common/auth/ca_config.c for ext2_rsa_key.

#--------------------------------
menuconfig HI_ADVCA_SANDBOX_SUPPORT
    bool "Support Advance CA Sandbox"
    depends on HI_ADVCA_SUPPORT && !HI3798MV100 && !HI3796MV100
    default y

choice
    prompt "CA Sandbox Type"
    depends on HI_ADVCA_SANDBOX_SUPPORT
    default SANDBOX_LXC
config  SANDBOX_CHROOT
    bool "Chroot"
    depends on HI_LOADER_APPLOADER
config  SANDBOX_LXC
    bool "LXC"
    depends on !HI_LOADER_APPLOADER

endchoice

config  HI_ADVCA_SANDBOX_TYPE
    string
    depends on HI_ADVCA_SANDBOX_SUPPORT
    default CHROOT        if SANDBOX_CHROOT
    default LXC           if SANDBOX_LXC

#--------------------------------
```

## scripts/kconfig/Kconfig.audio
```kconfig
menu "Audio Config"

config HI_AENC_SUPPORT
    bool "AENC Support"
    help
        when enabled, support audio encoder

    default y

config HI_ADEC_AUDSPECTRUM_SUPPORT
    bool "Audio Spectrum Support"
    help
        when enabled, support audio spectrum

    default n

config HI_AI_SUPPORT
    bool "AI Support"
    help
        when enabled, support audio input (for example, audio recorder)
    default n

config HI_SND_SMARTVOLUME_SUPPORT
    bool "Auto Volume Control Support"
    help
        when enabled, adjust the audio volume automatically
    default n

config HI_SND_HBRA_PASSTHROUGH_SUPPORT
    bool "SND HBRA passthrough support"
    default n if (HI3716MV410 || HI3716MV420)
    default y
    help
        when enabled, HBRA(TRUEHD DTSHD 7.1LPCM) passthrough is supported
        when not enabled, the memory consuming can be reduced

config HI_SND_PORT_DELAY_SUPPORT
    bool "SND Port Delay Support"
    help
        when enabled, the audio can be delayed in audio port intentional to sync the audio and video in the case when audio comes faster than video
    default n

menuconfig HI_ADAC_SUPPORT
    bool "ADAC Support"
    help
        when enabled, the default kernel driver of ADAC (Audio Digital Analog Converter) will be supported
    default n

choice
    prompt "Codec Support"
    depends on HI_ADAC_SUPPORT

config HI_ADAC_SLIC_SUPPORT
    bool "slic"
    help
        when enabled, telephone audio driver is supported

config HI_ADAC_TVL320AIC31_SUPPORT
    bool "tlv320"
    help
        when enabled, the driver of specific ADAC chip 'TVL320AIC31' can be supported

endchoice

config HI_ALSA_SUPPORT
    bool "ALSA Support"
    depends on !(HI_BLUETOOTH_SUPPORT)
    help
        when enabled, ALSA (Advanced Linux Sound Architecture) is supported
    default n

config HI_ALSA_LIB_SUPPORT
    bool "ALSA Library Support"
    help
        when enabled, the ALSA related libraries will be generated
    depends on LINUX_PRODUCT && HI_ALSA_SUPPORT
    default n

config HI_ALSA_DRIVER_SUPPORT
    bool "ALSA Driver Support"
    help
        when enabled, ALSA related driver will be compiled (into kernel or independent kernel module)
    depends on HI_ALSA_SUPPORT
    default n

config HI_SND_ALSA_AO_SUPPORT
    bool "ALSA AO Support"
    help
        when enabled, audio can be output by ALSA
    depends on HI_ALSA_DRIVER_SUPPORT
    default n

config HI_SND_ALSA_AI_SUPPORT
    bool "ALSA AI Support"
    help
        when enabled, audio can be input by ALSA
    depends on HI_ALSA_DRIVER_SUPPORT
    default n
    select HI_AI_SUPPORT

config HI_AUDIO_RESAMPLER_SUPPORT
    bool "Audio resampler Support"
    help
        when enabled, the resampler library will be generated
    default n if LINUX_PRODUCT
    default y if ANDROID_PRODUCT

config HI_SONIC_SUPPORT
    bool "SONIC SUPPORT"
    help
        when enabled, audio playback rate can be changed
    default n

config HI_KARAOKE_SUPPORT
    bool "Karaoke Support"
    help
        when enabled, the KARAOKE related libraries will be generated
    depends on ANDROID_PRODUCT
    default y
    select HI_AUDIO_RESAMPLER_SUPPORT

source "scripts/kconfig/Kconfig.hacodec"

endmenu
```
