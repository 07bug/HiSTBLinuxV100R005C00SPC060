## scripts/kconfig/Kconfig.base
```kconfig
###########################################################
choice
    prompt "Product Type"
    default LINUX_PRODUCT

config  LINUX_PRODUCT
    bool "linux"
    help
        set product type to Linux
config  ANDROID_PRODUCT
    bool "android"
    help
        set product type to Android
endchoice

config  PRODUCT_TYPE
    string
    default linux            if LINUX_PRODUCT
    default android          if ANDROID_PRODUCT

choice
    prompt "Android Type"
    default ANDROID_AOSP
    depends on ANDROID_PRODUCT

config  ANDROID_AOSP
    bool "AOSP"
config  ANDROID_TVOS
    bool "TVOS"
endchoice

choice
    prompt "Mode"
    default HI_USER_MODE

config  HI_USER_MODE
    bool "user"

config  HI_ENG_MODE
    bool "engineer"
endchoice

###########################################################
choice
    prompt "Chip Type"
    default HI3798CV200

config  HI3716MV410
    bool "hi3716mv410"
config  HI3716MV420
    bool "hi3716mv420"
config  HI3716MV450
    bool "hi3716mv450"
config  HI3798MV100
    bool "hi3798mv100"
config  HI3798MV200
    bool "hi3798mv200"
config  HI3798MV300
    bool "hi3798mv300"
config  HI3798MV310
    bool "hi3798mv310"
config  HI3798MV300H
    bool "hi3798mv300h"
config  HI3796MV100
    bool "hi3796mv100"
config  HI3796MV200
    bool "hi3796mv200"
config  HI3798CV200
    bool "hi3798cv200"
endchoice

config  HI_CHIP_TYPE
    string
    default hi3716mv410     if HI3716MV410
    default hi3716mv420     if HI3716MV420
    default hi3716mv450     if HI3716MV450
    default hi3798mv100     if HI3798MV100
    default hi3798mv200     if HI3798MV200
    default hi3798mv300     if HI3798MV300
    default hi3798mv300h    if HI3798MV300H
    default hi3798mv310     if HI3798MV310
    default hi3796mv100     if HI3796MV100
    default hi3796mv200     if HI3796MV200
    default hi3798cv200     if HI3798CV200

source "scripts/kconfig/Kconfig.advca"

config  HI_NVR_SUPPORT
    bool
    depends on LINUX_PRODUCT && (HI3798CV200 || HI3796MV200)
    default n
    help
        when enabled, NVR(Network Video Recorder) can be supported.

###########################################################
menu "System Config"

choice
    prompt "System Type"
    default HI_32BIT_SYSTEM

config  HI_32BIT_SYSTEM
    bool "32bit system"

config  HI_64BIT_SYSTEM
    bool "64bit system"
    depends on HI3798CV200 || HI3798MV200 || HI3798MV300 || HI3798MV300H || HI3798MV310 || HI3796MV200
endchoice

choice
    prompt "User Space Type"
    default HI_USER_SPACE_LIB if HI_32BIT_SYSTEM
    default HI_USER_SPACE_ALL_LIB if HI_64BIT_SYSTEM
    depends on LINUX_PRODUCT

config  HI_USER_SPACE_LIB
    bool "32bit"

config  HI_USER_SPACE_LIB64
    bool "64bit"
    depends on HI_64BIT_SYSTEM

config  HI_USER_SPACE_ALL_LIB
    bool "32bit + 64bit"
    depends on HI_64BIT_SYSTEM
endchoice

config  HI_CPU_ARCH
    string
    default arm     if HI_32BIT_SYSTEM
    default arm64   if HI_64BIT_SYSTEM

endmenu

menu "Toolchains Config"

choice
    prompt "32bit Toolchains"
    default ARM_HISTBV310_LINUX

config  ARM_HISTBV300_LINUX
    bool "arm-histbv300-linux"
    depends on (HI3716MV410 || HI3716MV420) && ADVCA_VERIMATRIX_ADVANCE

config  ARM_HISTBV310_LINUX
    bool "arm-histbv310-linux"
    depends on !(HI3796MV200 || HI3716MV450 || HI3798MV300 || HI3798MV300H || HI3798MV310)

config  ARM_HISTBV320_LINUX
    bool "arm-histbv320-linux"
    depends on HI3798CV200 || HI3798MV200 || HI3798MV300 || HI3798MV300H || HI3798MV310 || HI3796MV200 || HI3716MV450 || ((HI3716MV410 || HI3716MV420) && ADVCA_NAGRA)
endchoice

config  HI_ARM_TOOLCHAINS_NAME
    string
    default arm-histbv300-linux     if ARM_HISTBV300_LINUX
    default arm-histbv310-linux     if ARM_HISTBV310_LINUX
    default arm-histbv320-linux     if ARM_HISTBV320_LINUX

choice
    prompt "64bit Toolchains"
    default AARCH64_HISTBV100_LINUX

config   AARCH64_HISTBV100_LINUX
    bool "aarch64-histbv100-linux"
endchoice

config  HI_AARCH64_TOOLCHAINS_NAME
    string
    default aarch64-histbv100-linux if AARCH64_HISTBV100_LINUX

endmenu

config  HI_OUT_DIR
    string "Out DIR"
    default HI_CHIP_TYPE
    depends on LINUX_PRODUCT

config  HI_USB3_SUPPORT
    bool
    depends on !(HI3716MV410 || HI3716MV420 || HI3798MV310 || HI3798MV300H)
    default y

config  HI_SATA_SUPPORT
    bool
    depends on !(HI3798MV100 || HI3796MV100 || HI3716MV410 || HI3798MV310 || HI3798MV300H)
    default y

config  HI_JPGE_SUPPORT
    bool
    depends on !(HI3716MV410 || HI3798MV310 || HI3798MV300H)
    default y

config  HI_SMMU_SUPPORT
    bool
    depends on HI3798CV200 || HI3798MV200 || HI3798MV300 || HI3798MV300H || HI3798MV310 || HI3796MV200 || HI3716MV450
    default y

config  HI_HDR_SUPPORT
    bool
    depends on HI3798CV200 || HI3798MV200 || HI3798MV300 || HI3798MV300H || HI3798MV310 || HI3796MV200 || HI3716MV450
    default y

config  HI_HDR_DOLBYVISION_SUPPORT
    bool
    depends on HI_HDR_SUPPORT && (HI3798CV200 || HI3798MV200 || HI3798MV300 || HI3798MV300H || HI3798MV310 || HI3796MV200)
    default y

config  HI_MAILBOX_SUPPORT
    bool
    depends on HI3796MV200 || HI3716MV450
    default y

config  HI_SM_SUPPORT
    bool
    depends on (HI3796MV200 || HI3716MV450) && HI_TEE_SUPPORT && HI_ADVCA_SUPPORT && (ADVCA_CONAX || ADVCA_IRDETO || ADVCA_NAGRA || ADVCA_VERIMATRIX_ULTRA)
    default y

config  HI_OTP_KLAD_V100
    bool
    depends on ((HI3716MV410 || HI3716MV420) && !ADVCA_NAGRA) || HI3798MV100 || HI3796MV100 || HI3798CV200 || HI3798MV200 || HI3798MV300 || HI3798MV300H || HI3798MV310
    default y

config  HI_OTP_KLAD_V200
    bool
    depends on HI3796MV200 || HI3716MV450 || ((HI3716MV410 || HI3716MV420) && ADVCA_NAGRA)
    default y

config  HI_TEE_SMP_SUPPORT
    bool
    depends on HI_TEE_SUPPORT
    default y if !ADVCA_SUMA
    default n if ADVCA_SUMA

config HI_OPTM_SIZE_SUPPORT
    bool "Optimize For Size"
    help
        optimize the compilation target size by using "-ffunction-sections" flags
    default n
```

## scripts/kconfig/Kconfig.bluetooth
```kconfig
#+++++++++++++++++++++++++++++++++++++++++++++++++++
#--------------------------------
menuconfig HI_BLUETOOTH_SUPPORT
    bool "Bluetooth Support"
    depends on LINUX_PRODUCT
    default n
    help
        when enabled, the following bluetooth devices can be supported

menu    "BlueTooth Device Type"
    depends on HI_BLUETOOTH_SUPPORT

config  HI_BLUETOOTH_DEVICE_RTL8723BU
    bool "Realtek rtl8723bu bluetooth driver"
config  HI_BLUETOOTH_DEVICE_RTL8761AU
    bool "Realtek rtl8761au bluetooth driver"
config  HI_BLUETOOTH_DEVICE_RTL8821AU
    bool "Realtek rtl8821au bluetooth driver"
config  HI_BLUETOOTH_DEVICE_RTL8822BU
	bool "Realtek rtl8822bu bluetooth driver"
config  HI_BLUETOOTH_DEVICE_RTL8822BEH
	bool "Realtek rtl8822beh bluetooth driver"
config  HI_BLUETOOTH_DEVICE_MT76X2
    bool "Mtk mt76x2tu bluetooth driver"
config  HI_BLUETOOTH_DEVICE_CSR851X
    bool "Csr851x bluetooth driver"
endmenu
```

## scripts/kconfig/Kconfig.board.audio
```kconfig
#+++++++++++++++++++++++++++++++++++++++++++++++++++
menuconfig HI_SND_MUTECTL_SUPPORT
    bool "Snd Mute Control Support"
    default n

config HI_SND_MUTECTL_GPIO
    hex  "Snd Mute Control Gpio"
    depends on HI_SND_MUTECTL_SUPPORT
    default 0x14
    help
        set specific GPIO to mute

config HI_SND_MUTECTL_LEVEL
    int "Snd Mute Control Level (0, 1)"
    depends on HI_SND_MUTECTL_SUPPORT
    range 0 1
    default 0
    help
        use high level or low level of GPIO to mute, 1: mute by high level, 0: mute by low level

choice
    prompt "Audio Amplifier"
    depends on (HI3798MV300 || HI3798MV300H || HI3798MV310)
    default HI_AUDIO_EXTERNAL_AMP

config HI_AUDIO_EXTERNAL_AMP
    bool "External Amplifier"
    help
        use external amplifier

config HI_AUDIO_INTERNAL_AMP
    bool "Internal Amplifier"
    help
        use internal amplifier inside chipset

endchoice

#+++++++++++++++++++++++++++++++++++++++++++++++++++
```

## scripts/kconfig/Kconfig.board.demux.tso1
```kconfig
#+++++++++++++++++++++++++++++++++++++++++++++++++++
menu "TSO1 Config"
#----------------------clk frequency----------------------
choice
    prompt "Clock Frequency"
    help
        set TSO0 clock frequency according to the target device on the board
    default 150M

config  HI_TSO1_CLK_100M
    bool "100M"
config  HI_TSO1_CLK_150M
    bool "150M"
config  HI_TSO1_CLK_1200M
    bool "1200M"
config  HI_TSO1_CLK_1500M
    bool "1500M"
endchoice
#----------------------clk mode----------------------
choice
    prompt "Clock Mode"
    help
        The TSO out clock mode
    default normal

config  HI_TSO1_CLK_MODE_NORMAL
    bool "normal"
config  HI_TSO1_CLK_MODE_JITTER
    bool "jitter"
endchoice
#----------------------valid------------------------------
choice
    prompt "Valid Signal Mode"
    help
        signal mode on TSO1 port
    default active_output

config  HI_TSO1_VALID_ACTIVE_OUTPUT
    bool "active_output"
config  HI_TSO1_VALID_ACTIVE_HIGH
    bool "active_high"
endchoice
#----------------------serial or parallel----------------------
choice
    prompt "Serial or Parallel"
    help
        output mode on TSO1 port
    default serial

config  HI_TSO1_SERIAL
    bool "serial"
config  HI_TSO1_PARALLEL
    bool "parallel"
endchoice
#----------------------bit selector----------------------
choice
    prompt "Bit Selector"
    help
       Port bit selector:
         0     -- D7 is the data line of serial mode or the MSB of parallel mode
         1     -- D0 is the data line of serial mdoe or the MSB of parallel mode
    default 0

config  HI_TSO1_SERIAL_BIT_0
    bool "0"
config  HI_TSO1_SERIAL_BIT_7
    bool "7"
endchoice

endmenu
#+++++++++++++++++++++++++++++++++++++++++++++++++++
```

## scripts/kconfig/Kconfig.board.dongle
```kconfig
menu "Dongle Config"
    depends on HI3798CV200 || HI3798MV200 || HI3798MV300 || HI3798MV300H || HI3798MV310

config  HI_DONGLE_SUPPORT
    bool "Dongle Board Support"
    default n
    help
        when enabled, dongle board is supported, and bootargs_dongle.bin will be generated to images directory.

endmenu
```

## scripts/kconfig/Kconfig.board.eth
```kconfig
#+++++++++++++++++++++++++++++++++++++++++++++++++++
menu "Ethernet Config"
config  HI_ETH_SUPPORT
    bool "Ethernet Support"
    default y
    help
        enable ethernet function in boot image

endmenu
#+++++++++++++++++++++++++++++++++++++++++++++++++++
```

## scripts/kconfig/Kconfig.board.keyled
```kconfig
choice
    prompt "Keyled Device Used"
    default HI_KEYLED_CT1642_SELECT
config  HI_KEYLED_74HC164_SELECT
    bool "74HC164"
    depends on HI_KEYLED_74HC164_SUPPORT
config  HI_KEYLED_GPIOKEY_SELECT
    bool "GPIO KEY"
    depends on HI_KEYLED_GPIOKEY_SUPPORT
config  HI_KEYLED_CT1642_SELECT
    bool "CT1642"
    depends on HI_KEYLED_CT1642_SUPPORT
config  HI_KEYLED_PT6961_SELECT
    bool "PT6961"
    depends on HI_KEYLED_PT6961_SUPPORT
config  HI_KEYLED_PT6964_SELECT
    bool "PT6964"
    depends on HI_KEYLED_PT6964_SUPPORT
config  HI_KEYLED_FD650_SELECT
    bool "FD650"
    depends on HI_KEYLED_FD650_SUPPORT
endchoice

config  HI_GPIO_LIGHT_SUPPORT
    bool "Gpio Light Support"
    default n
    help
        When this option is 'y', it means supporting the gpio-LED control during standby & resume process.

config  HI_POSITIVE_GPIO_LIGHT_NUMBER
    depends on HI_GPIO_LIGHT_SUPPORT
    hex "Positive Gpio Number"
    default 0x2f
    help
        The gpio port of the LED whose electrical level is set to be low when standby, and set to be high when resume.

config  HI_NEGATIVE_GPIO_LIGHT_NUMBER
    depends on HI_GPIO_LIGHT_SUPPORT
    hex "Negative Gpio Number"
    default 0x2f
    help
        The gpio port of the LED whose electrical level is set to be high when standby, and set to be low when resume.

config  HI_POSITIVE_GPIO_LIGHT_NUMBER_QFP
    depends on HI_GPIO_LIGHT_SUPPORT && HI3798MV100
    hex "Positive Gpio Number For QFP"
    default 0x2a
    help
        The gpio port of the LED whose electrical level is set to be high when standby, and set to be low when resume
        in Hi3798MV100 QFP package chip.
```

## scripts/kconfig/Kconfig.board.tuner
```kconfig
#+++++++++++++++++++++++++++++++++++++++++++++++++++
menu "Tuner Config"
    depends on !HI3798MV100

config HI_TUNER_NUMBER
    int "Tuner Number"
    default 1
    range 0 8
    help
       Configure the number of tuner on the board

source "scripts/kconfig/Kconfig.board.tuner0"
source "scripts/kconfig/Kconfig.board.tuner1"
source "scripts/kconfig/Kconfig.board.tuner2"
source "scripts/kconfig/Kconfig.board.tuner3"
source "scripts/kconfig/Kconfig.board.tuner4"
source "scripts/kconfig/Kconfig.board.tuner5"
source "scripts/kconfig/Kconfig.board.tuner6"
#source "scripts/kconfig/Kconfig.board.tuner7"

endmenu
#+++++++++++++++++++++++++++++++++++++++++++++++++++
```

## scripts/kconfig/Kconfig.board.videodac
```kconfig
#+++++++++++++++++++++++++++++++++++++++++++++++++++
menu "Video DAC Config"

config HI_DAC_CVBS
    int "CVBS DAC number"
    range 0 5
    depends on !HI_NVR_SUPPORT
    help
        set DAC number used as CVBS.

choice
    prompt "CVBS Circuit Type"
    default HI_VO_VDAC_VIDEO_BUFFER

config  HI_VO_VDAC_LC_CIRCUIT
    bool "LC"

config  HI_VO_VDAC_VIDEO_BUFFER
    bool "Video Buffer"

endchoice

config HI_YPBPR_SUPPORT
    bool "YPBPR Support"
    depends on !HI_NVR_SUPPORT && (HI3716MV410 || HI3716MV420 || HI3716MV450 || HI3796MV200)
    default y

config HI_DAC_YPBPR_Y
    int "YPBPR_Y DAC number"
    range 0 5
    depends on HI_YPBPR_SUPPORT
    help
        set DAC number used as YPBPR_Y.

config HI_DAC_YPBPR_PB
    int "YPBPR_PBD DAC number"
    range 0 5
    depends on HI_YPBPR_SUPPORT
    help
        set DAC number used as YPBPR_PB.

config HI_DAC_YPBPR_PR
    int "YPBPR_PR DAC number"
    range 0 5
    depends on HI_YPBPR_SUPPORT
    help
        set DAC number used as YPBPR_PR.

choice
    prompt "YPBPR Circuit Type"
    depends on HI_YPBPR_SUPPORT
    default HI_VO_YPBPR_VDAC_VIDEO_BUFFER

config  HI_VO_YPBPR_VDAC_LC_CIRCUIT
    bool "LC"

config  HI_VO_YPBPR_VDAC_VIDEO_BUFFER
    bool "Video Buffer"

endchoice

config HI_VGA_SUPPORT
    bool "VGA Support"
    depends on HI_NVR_SUPPORT && HI3796MV200
    default n

config HI_DAC_VGA_R
    int "VGA_R DAC number"
    range 0 5
    depends on HI_VGA_SUPPORT
    help
        set DAC number used as VGA_R.

config HI_DAC_VGA_G
    int "VGA_GDAC number "
    range 0 5
    depends on HI_VGA_SUPPORT
    help
        set DAC number used as VGA_G.

config HI_DAC_VGA_B
    int "VGA_B DAC number"
    range 0 5
    depends on HI_VGA_SUPPORT
    help
        set DAC number used as VGA_B.
endmenu
#+++++++++++++++++++++++++++++++++++++++++++++++++++
```

## scripts/kconfig/Kconfig.caption
```kconfig
#+++++++++++++++++++++++++++++++++++++++++++++++++++
menu "Caption Config"

#------------------------------------------------
config  HI_CAPTION_SUBT_SUPPORT
    bool "Subtitle Support"
    help
        when enabled, subtitle can be supported
    default n

#------------------------------------------------
config  HI_CAPTION_TTX_SUPPORT
    bool "Teletext Support"
    help
        when enabled, teletext can be supported        
    default n

#------------------------------------------------
config  HI_CAPTION_SO_SUPPORT
    bool "Subtitle Output Support"
    help
        part of subtitle, 'Subtitle Output' can be used for other modules
    default y

#------------------------------------------------
config  HI_CAPTION_CC_SUPPORT
    bool "Closed Caption Support"
    help
        when enabled, 'Closed Caption' can be supported
    default n

#------------------------------------------------
endmenu
#+++++++++++++++++++++++++++++++++++++++++++++++++++
```
