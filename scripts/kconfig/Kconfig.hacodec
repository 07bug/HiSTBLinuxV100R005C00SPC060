## scripts/kconfig/Kconfig.hacodec
```kconfig
menuconfig HI_HACODEC_SUPPORT
    bool "Audio Codec Support"
    default y

config HI_HACODEC_MP3DECODE_SUPPORT
    bool "MP3 Decoder Support"
    depends on HI_HACODEC_SUPPORT
    default n

config HI_HACODEC_AACDECODE_SUPPORT
    bool "AAC Decoder Support"
    depends on HI_HACODEC_SUPPORT
    default n

config HI_HACODEC_AACENCODE_SUPPORT
    bool "AAC Encode Support"
    depends on HI_HACODEC_SUPPORT
    default n

config HI_HACODEC_AC3PASSTHROUGH_SUPPORT
    bool "AC3 Passthrough Support"
    depends on HI_HACODEC_SUPPORT
    default n

config HI_HACODEC_AMRNBCODEC_SUPPORT
    bool "AMRNB Codec Support"
    depends on HI_HACODEC_SUPPORT
    default n

config HI_HACODEC_AMRWBCODEC_SUPPORT
    bool "AMRWB Codec Support"
    depends on HI_HACODEC_SUPPORT
    default n

config HI_HACODEC_BLURAYLPCMDECODE_SUPPORT
    bool "BLURAYLPCM Decoder Support"
    depends on HI_HACODEC_SUPPORT
    default n

config HI_HACODEC_COOKDECODE_SUPPORT
    bool "COOK Decoder Support"
    depends on HI_HACODEC_SUPPORT
    default n

config HI_HACODEC_DRADECODE_SUPPORT
    bool "DRA Decoder Support"
    depends on HI_HACODEC_SUPPORT
    default n

config HI_HACODEC_DTSPASSTHROUGH_SUPPORT
    bool "DTS Passthrough Support"
    depends on HI_HACODEC_SUPPORT
    default n

config HI_HACODEC_G711CODEC_SUPPORT
    bool "G711 Codec Support"
    depends on HI_HACODEC_SUPPORT
    default n

config HI_HACODEC_G722CODEC_SUPPORT
    bool "G722 Codec Support"
    depends on HI_HACODEC_SUPPORT
    default n

config HI_HACODEC_PCMDECODE_SUPPORT
    bool "PCM Decoder Support"
    depends on HI_HACODEC_SUPPORT
    default n

config HI_HACODEC_TRUEHDPASSTHROUGH_SUPPORT
    bool "TRUEHD Passthrough Support"
    depends on HI_HACODEC_SUPPORT
    default n

config HI_HACODEC_DTSM6DECODE_SUPPORT
    bool "DTSM6 Decoder Support"
    depends on HI_HACODEC_SUPPORT && ANDROID_PRODUCT
    default n
```

## scripts/kconfig/Kconfig.hdmi
```kconfig
#+++++++++++++++++++++++++++++++++++++++++++++++++++
menu "HDMI Config"

config  HI_HDMI_SUPPORT_1_4
    bool
    depends on HI3798MV100 || HI3796MV100 || HI3716MV410 || HI3716MV420
    default y

config  HI_HDMI_SUPPORT_2_0
    bool
    depends on HI3798CV200 || HI3798MV200 || HI3798MV300 || HI3798MV300H || HI3798MV310 || HI3796MV200 || HI3716MV450
    default y

config  HI_HDMI_SUPPORT_HDCP
    bool "HDCP Support"
    help
      If you want to enable HDCP, say y.
    default n

config  HI_HDMI_SUPPORT_CEC
    bool "CEC Support"
    help
      If you want to enable CEC, say y.
    default n

config  HI_HDMI_CEC_FORCE_RAWDATA
    bool "CEC OPERAND FORCE RAWDATA"
    depends on HI_HDMI_SUPPORT_CEC
    help
      If you just want to use RAWDATA for cec message, say y; or you can use RAWDATA and UICommand for cec message.
    default n

config  HI_HDMI_SUPPORT_DEBUG
    bool "DEBUG Support"
    help
        enable debug messages
    default n

config  HI_HDMI_DEBUG_MEM_SIZE
    hex "DEBUG Memory Size (BYTE)"
    help
      set debug memory size inside SDK, note that this debug memory is only used in development stage and is used for storing debug messages.
    default 0x80000

config  HI_HDMI_START_SUPPORT
    bool "HDMI Start Support"
    help
        If you want to control HDMI START only by HI_UNF_HDMI_Start(), say y;or it will start automatically in some case,such as CHANGE DISP FORMAT,etc.
    default n

endmenu
#+++++++++++++++++++++++++++++++++++++++++++++++++++
```

## scripts/kconfig/Kconfig.keyprovision
```kconfig
config  HI_KEYPROVISION_SUPPORT
    depends on (HI3796MV200 || HI3716MV450 || HI3798MV300 || HI3798MV300H || HI3798MV310)
    bool "Keyprovision Support"
    default n
```

## scripts/kconfig/Kconfig.loader
```kconfig
menuconfig HI_UPGRADE_SUPPORT
    bool "Upgrade Support"
    depends on !HI_NVR_SUPPORT
    default n

#------------------------------------------------
choice
    prompt "Loader Type"
    default HI_RECOVERY_SUPPORT     if ANDROID_PRODUCT
    default HI_APPLOADER_SUPPORT    if LINUX_PRODUCT
    depends on HI_UPGRADE_SUPPORT

config HI_RECOVERY_SUPPORT
    bool "Recovery"
    depends on ANDROID_PRODUCT

config HI_APPLOADER_SUPPORT
    bool "AppLoader"

#config HI_BOOTLOADER_SUPPORT
#    bool "BootLoader"

endchoice

config  HI_LOADER_SUPPORT
    bool
    default y
    depends on HI_UPGRADE_SUPPORT && (HI_APPLOADER_SUPPORT || HI_BOOTLOADER_SUPPORT)

#------------------------------------------------

config HI_LOADER_APPLOADER
    bool "Build AppLoader images"
    default n
    depends on HI_UPGRADE_SUPPORT && HI_APPLOADER_SUPPORT

#------------------------------------------------

choice
    prompt "File Protocol"
    default HI_LOADER_PROTOCOL_HISI_FILE
    depends on HI_UPGRADE_SUPPORT && ((HI_APPLOADER_SUPPORT && HI_LOADER_APPLOADER) || (HI_BOOTLOADER_SUPPORT))
config  HI_LOADER_PROTOCOL_HISI_FILE
    bool "Hisi File Protocol"
endchoice

#------------------------------------------------
choice
    prompt "OTA Protocol"
    default HI_LOADER_PROTOCOL_HISI_OTA
    depends on HI_UPGRADE_SUPPORT && ((HI_APPLOADER_SUPPORT && HI_LOADER_APPLOADER) || (HI_BOOTLOADER_SUPPORT)) && HI_FRONTEND_SUPPORT

config  HI_LOADER_PROTOCOL_HISI_OTA
    bool "Hisi OTA Protocol"
config  HI_LOADER_PROTOCOL_SSU_OTA
    bool "SSU OTA Protocol"
endchoice

#------------------------------------------------
choice
    prompt "OSD Language"
    default HI_APPLOADER_OSD_LANG_EN
    depends on HI_UPGRADE_SUPPORT && ((HI_APPLOADER_SUPPORT && HI_LOADER_APPLOADER) || (HI_BOOTLOADER_SUPPORT))

config  HI_APPLOADER_OSD_LANG_EN
    bool "English"

config  HI_APPLOADER_OSD_LANG_CN
    bool "Chinese"
    depends on HI_LOADER_APPLOADER
endchoice

#------------------------------------------------
config  HI_APPLOADER_ANTI_ROLLBACK
    bool "Anti-Rollback Support"
    default y
    depends on HI_UPGRADE_SUPPORT && ((HI_APPLOADER_SUPPORT && HI_LOADER_APPLOADER) || (HI_BOOTLOADER_SUPPORT))

#------------------------------------------------
config  HI_APPLOADER_MODE_USB
    bool "USB Upgrade Support"
    default y
    depends on HI_UPGRADE_SUPPORT && ((HI_APPLOADER_SUPPORT && HI_LOADER_APPLOADER) || (HI_BOOTLOADER_SUPPORT))

#------------------------------------------------
config  HI_APPLOADER_MODE_FS
    bool "FileSystem Upgrade Support"
    default y if HI_APPLOADER_SUPPORT
    default n if HI_BOOTLOADER_SUPPORT
    depends on HI_UPGRADE_SUPPORT && ((HI_APPLOADER_SUPPORT && HI_LOADER_APPLOADER) || (HI_BOOTLOADER_SUPPORT))

#------------------------------------------------
config  HI_APPLOADER_MODE_IP
    bool "IP Upgrade Support"
    default y if HI_APPLOADER_SUPPORT
    default n if HI_BOOTLOADER_SUPPORT
    depends on HI_UPGRADE_SUPPORT && ((HI_APPLOADER_SUPPORT && HI_LOADER_APPLOADER) || (HI_BOOTLOADER_SUPPORT)) && !HI_ADVCA_SUPPORT
    select HI_CURL_SUPPORT

#------------------------------------------------

menuconfig HI_APPLOADER_MODE_OTA
    bool "OTA Upgrade Support"
    default y if HI_APPLOADER_SUPPORT
    default n if HI_BOOTLOADER_SUPPORT
    depends on HI_UPGRADE_SUPPORT && ((HI_APPLOADER_SUPPORT && HI_LOADER_APPLOADER) || (HI_BOOTLOADER_SUPPORT)) && HI_FRONTEND_SUPPORT

#------------------------------------------------
choice
    prompt "Tuner Type"
    default HI_APPLOADER_TUNER_CAB
    depends on HI_APPLOADER_MODE_OTA

config  HI_APPLOADER_TUNER_CAB
    bool "Cable"

config  HI_APPLOADER_TUNER_SAT
    bool "Satellite"

config  HI_APPLOADER_TUNER_DVB_T
  bool "Terrestrial DVB_T"

config  HI_APPLOADER_TUNER_DVB_T2
  bool "Terrestrial DVB_T2"
endchoice

#------------------------------------------------
config HI_APPLOADER_TUNER_INDEX
    int "Tuner Port Index (0,3)"
    range 0 3
    default 0
    depends on HI_APPLOADER_MODE_OTA
    ---help---
        This option controls tuner port index, range from 0 to 3.
          0-the cable tuner port index
          1-the cable tuner port index
          2-the cable tuner port index
          3-the cable tuner port index
          Default 0.
        NOTICE: This value control the tuner port index, the default value always 0(cable).
#------------------------------------------------


#------------------------------------------------
config  HI_APPLOADER_INITRD_BASE_ADDR
    hex "Initrd filesystem base addr in mkbootimg tool"
    default 0x3500000
    depends on HI_UPGRADE_SUPPORT && (HI_APPLOADER_SUPPORT && HI_LOADER_APPLOADER) && ADVCA_CONAX
    help
    Initrd filesystem base addr in mkbootimg tool,if initrd=0x4500000 in bootargs,here need set it as 0x3500000
    As mkbootimg will add 0x1000000 kernel space before fs position.

source "scripts/kconfig/Kconfig.curl"
```

## scripts/kconfig/Kconfig.mce
```kconfig
config  HI_MCE_SUPPORT
    bool "Fastplay Support"
    default n
    select HI_MSP_BUILDIN

config  HI_GRADUAL_VOLUME_SUPPORT
    bool "Gradual Volume Support"
    depends on  HI_MCE_SUPPORT && (HI3798MV200 || HI3798MV300 || HI3798MV300H || HI3798MV310 || HI3796MV200 || HI3716MV450)
    default n
```

## scripts/kconfig/Kconfig.omx
```kconfig
menuconfig HI_OMX_SUPPORT
    bool "OMX Support"
    default n if LINUX_PRODUCT
    default y if ANDROID_PRODUCT
```

## scripts/kconfig/Kconfig.peripherals
```kconfig
menu "Peripherals Config"
source "scripts/kconfig/Kconfig.ir"
source "scripts/kconfig/Kconfig.keyled"
source "scripts/kconfig/Kconfig.sci"
source "scripts/kconfig/Kconfig.gpioi2c"
source "scripts/kconfig/Kconfig.spi"
endmenu
```

## scripts/kconfig/Kconfig.system
```kconfig
menu "Kernel"
source "scripts/kconfig/Kconfig.kernel"
endmenu

menu "Filesystem"
source "scripts/kconfig/Kconfig.filesystem"
endmenu

menu "Tools"
source "scripts/kconfig/Kconfig.tools"
endmenu

menu "Features"
source "scripts/kconfig/Kconfig.frontend"
source "scripts/kconfig/Kconfig.demux"
source "scripts/kconfig/Kconfig.tsio"
source "scripts/kconfig/Kconfig.audio"
source "scripts/kconfig/Kconfig.video"
source "scripts/kconfig/Kconfig.graphics"
source "scripts/kconfig/Kconfig.hdmi"
source "scripts/kconfig/Kconfig.avplay"
source "scripts/kconfig/Kconfig.gpu"
source "scripts/kconfig/Kconfig.peripherals"
source "scripts/kconfig/Kconfig.pm"
source "scripts/kconfig/Kconfig.pvr"
source "scripts/kconfig/Kconfig.caption"
source "scripts/kconfig/Kconfig.crypto"
source "scripts/kconfig/Kconfig.ci"
source "scripts/kconfig/Kconfig.omx"
source "scripts/kconfig/Kconfig.mce"
source "scripts/kconfig/Kconfig.hiplayer"
source "scripts/kconfig/Kconfig.gstreamer"
source "scripts/kconfig/Kconfig.wifi"
source "scripts/kconfig/Kconfig.bluetooth"
source "scripts/kconfig/Kconfig.drm"
source "scripts/kconfig/Kconfig.vp"
source "scripts/kconfig/Kconfig.keyprovision"
endmenu
```

## scripts/kconfig/Kconfig.tee
```kconfig
menuconfig HI_TEE_SUPPORT
    bool "TEE System"
    depends on !(HI3716MV410 || HI3716MV420)
    default n
    help
        when enabled, Trusted Execution Environment(TEE) can be supported
        Please say n here as dedault, unless you really know what are you doing.

choice
    prompt "SecureOS Type"
    depends on HI_TEE_SUPPORT
    default HI_TRUSTEDCORE_SUPPORT

config HI_TRUSTEDCORE_SUPPORT
    bool "Trustedcore"
    help
        when enabled, secure os will be selected as Trustedcore

config HI_OPTEE_SUPPORT
    bool "Optee"
    help
        when enabled, secure os will be selected as OPTEE (Open TEE)
    depends on (HI3796MV200 || HI3716MV450)
endchoice

config HI_TEE_LOG_SUPPORT
    bool "Log Support"
    help
       when disabled, close the log of secure os
    depends on HI_TEE_SUPPORT
    default y

choice
    prompt "Board Memory Size"
    depends on HI_TEE_SUPPORT && (HI3798MV100 || HI3796MV100 || HI3798CV200 || HI3798MV200 || HI3798MV300)
    default 1G

config TVP_MEM_1G
    bool "1G"
    help
        select it when DDR size is 1G

config TVP_MEM_2G
    bool "2G"
    help
        select it when DDR size is 2G

endchoice

config HI_TVP_MEM_LAYOUT
    string
    depends on HI_TEE_SUPPORT && (HI3798MV100 || HI3796MV100 || HI3798CV200 || HI3798MV200 || HI3798MV300)
    default 1G      if TVP_MEM_1G
    default 2G      if TVP_MEM_2G
```

## scripts/kconfig/Kconfig.tools
```kconfig
menuconfig HI_NTFS_SUPPORT
    bool "NTFS Support"
    default n

config  HI_NTFS_TOOLS_SUPPORT
    bool "NTFS Tools Support"
    depends on HI_NTFS_SUPPORT
    default y

config HI_EXFAT_SUPPORT
    bool "exFAT Support"
    default n

config HI_TOOL_DOSFS_SUPPORT
    bool "Dosfs Tools Support"
    help
        Customers need to download the source package by themselves.
        If not, choose this option will result in compile error. Please see the readme in source/rootfs/dosfstools.
    default n

config HI_TOOL_E2FSPROGS_SUPPORT
    bool "Ext2/Ext3 Tools Support"
    default n

config HI_TOOL_FILECAP_SUPPORT
    bool "Filecap Tools Support"
    default n
    help
        Filecap is used to change permission of files/dirs.
        Only for CA user, if don't use CA, say n here.

config HI_TOOL_GDB_SUPPORT
    bool "GDB/GDBServer Tools Support"
    depends on HI_ENG_MODE
    help
        Customers need to download the source package by themselves.
        If not, choose this option will result in compile error. Please see the readme in source/rootfs/gdb.
    default n

config HI_TOOL_IPTABLES_SUPPORT
    bool "Iptables Tools Support"
    default n

config HI_TOOL_MTDUTILS_SUPPORT
    bool "Mtdutils Tools Support"
    default n

config HI_TOOL_REG_SUPPORT
    bool "Read/Write Registers Tools Support"
    depends on HI_ENG_MODE
    default y

config HI_TOOL_SANDBOX_SUPPORT
    bool "Sandbox Tool(Chroot) Support"
    default y
    depends on HI_ADVCA_SANDBOX_TYPE = CHROOT
    help
        This tools is used only for CA, if no CA,say n here.

config HI_TOOL_PPPD_SUPPORT
    bool "PPPD Tool Support"
    default n

config HI_TOOL_MIITOOLS_SUPPORT
    bool "Mii Tool Support"
    default n

config HI_TOOL_IPERF_SUPPORT
    bool "Iperf Support"
    default n

config  HI_TOOL_LXC_CONTAINER_SUPPORT
    bool "LXC Container Tools Support"
    default y
    depends on HI_ADVCA_SANDBOX_TYPE = LXC

config HI_TOOL_SYSSTAT_SUPPORT
    bool "Sysstat Tool Support"
    default n

config HI_TOOL_SOC_SERVER
    bool "SOC Server Tool Support"
    default n

config HI_TOOL_MSP_DEBUG_SUPPORT
    bool "Msp Debug Tool Support"
    default n

config HI_TOOL_PQ_DEBUG_SUPPORT
    bool "PQ Debug Tool Support"
    default y
```

## scripts/kconfig/Kconfig.vdec
```kconfig
config HI_VIDEO_MAX_REF_FRAME_NUM
    int "Max reference frame number(3-16)"
    depends on (HI3716MV410 || HI3716MV420 || HI3798MV100 || HI3796MV100)
    range 3 16
    default 6
    help
        set Max reference frame number which ranges from 3 to 16

config HI_VIDEO_MAX_DISP_FRAME_NUM
    int "Extra frame number for schedule(2-16)"
    range 2 16
    default 4
    help
        set Max reference frame number which ranges from 2 to 16

config HI_VDEC_MJPEG_SUPPORT
    bool "Motion JPEG Decoder Support"
    default n
    help
        when enabled, Motion JPEG stream decoder is supported

config HI_VDEC_USERDATA_CC_SUPPORT
    bool "CC or AFD Support"
    default y
    help
        when enabled, Closed Caption(CC) or Active Format Description(AFD) user data can be received

config HI_VDEC_USERDATA_CC_BUFSIZE
    hex "CC or AFD Buffer Size"
    depends on HI_VDEC_USERDATA_CC_SUPPORT
    range 0x4000 0x40000
    default 0xC000
    help
        Closed Caption(CC) or Active Format Description(AFD) user data buffer size, recommend: 0xC000
```

## scripts/kconfig/Kconfig.vi
```kconfig
config  HI_VI_SUPPORT
    bool "VI Support"
    help
        video input for video phone case
    default n
```

## scripts/kconfig/Kconfig.video
```kconfig
menu "Video Config"
source "scripts/kconfig/Kconfig.vdec"
source "scripts/kconfig/Kconfig.venc"
source "scripts/kconfig/Kconfig.vo"
source "scripts/kconfig/Kconfig.vi"
endmenu
```
