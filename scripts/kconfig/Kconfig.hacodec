## scripts/kconfig/Kconfig.vo
```kconfig
config  HI_VPSS_MAX_BUFFER_NUMB
    int "Vpss Port OutBuffer Max Number(6~20)"
    help
        set max number of output buffer for each VPSS port
    range 6 20
    default 10

config  HI_DISP_USE_QPLL_SOLELY
    bool "QPLL Be Used By Display Solely"
    help
        when enabled, QPLL is only used by Display and display can suppport dobuble HD output with different pixel clock.
    default n

config  HI_DISP_TTX_INBUFFERSIZE
    hex "TTX Input Buffer Size"
    help
        Adjust input buffer size of teletext
    default 0x4000

config  HI_DISP_CC_INBUFFERSIZE
    hex "SD CC Input Buffer Size"
    help
        Adjust input buffer size of Closed Caption
    default 0x4000

config  HI_VDP_VIDEO_LINEDCMP
    bool
    help
        when enabled, the specific compressed YUV data will be de-compressed, for Capture case
    depends on (HI3716MV410 || HI3716MV420)
    default y

config  HI_PQ_V3_0
    bool
    depends on HI3798MV100 || HI3796MV100 || HI3716MV410 || HI3716MV420
    default y

config  HI_PQ_V4_0
    bool
    depends on HI3798CV200 || HI3798MV200 || HI3798MV300 || HI3798MV300H || HI3798MV310 || HI3796MV200 || HI3716MV450
    default y

config  HI_DISP_VIRT_OFFSET_EFFECT_WHEN_FULLSCREEN
    bool "Disp Offset Take Effect When Window Full Screen."
    default n if ANDROID_PRODUCT
    default n if LINUX_PRODUCT
    help
        when enabled, the range of window size will also be affected by display offset even when window is in full screen

config  HI_GFX_SDR2HDR_WEAK_PARA
    bool "Low Saturation Color Para For Gfx Transfer To Hdr Output."
    default n if ANDROID_PRODUCT
    default n if LINUX_PRODUCT
    help
        when enabled, graphic will use low saturation color para when input SDR but output HDR signal.
```

## scripts/kconfig/Kconfig.vp
```kconfig
config  HI_VP_SUPPORT
    depends on HI_VI_SUPPORT && HI_VENC_SUPPORT && !HI_VO_SINGLE_VIDEO_SUPPORT && HI_VDEC_MJPEG_SUPPORT
    bool "VP Support"
    help
        when enabled, video phone is supported
    default n
```

## scripts/kconfig/Kconfig.wifi
```kconfig
#+++++++++++++++++++++++++++++++++++++++++++++++++++
#--------------------------------
menuconfig HI_WIFI_SUPPORT
    bool "WiFi Support"
    default n
    depends on LINUX_PRODUCT
    help
      This section lists all supported 802.11 wireless device drivers.
      Please set to 'y' to support this device, otherwise set to 'n'.

menu    "WiFi Device Type"
    depends on HI_WIFI_SUPPORT

config  HI_WIFI_DEVICE_RTL8188EUS
    bool "Realtek RTL8188ETV and RTL8188EUS (11n 1x1 2.4G USB)"

config  HI_WIFI_DEVICE_RTL8192EU
    bool "Realtek RTL8192EU (11n 2x2 2.4G USB)"
    depends on HI_32BIT_SYSTEM && (HI3798CV200 || HI3798MV200 || HI3798MV300 || HI3798MV300H || HI3798MV310 || HI3796MV200 || HI3716MV450)

config  HI_WIFI_DEVICE_RTL8188FU
    bool "Realtek RTL8188FTV(11n 1x1 2.4G USB)"
    depends on HI_32BIT_SYSTEM && (HI3798MV100 || HI3796MV100 || HI3798CV200 || HI3798MV200 || HI3798MV300 || HI3798MV300H || HI3798MV310 || HI3796MV200 || HI3716MV450)

config  HI_WIFI_DEVICE_RTL8812AE
    bool "Realtek RTL8812AE (11ac 2x2 2.4G+5G PCIE)"
    depends on (HI3716MV410 || HI3716MV420)

config  HI_WIFI_DEVICE_RTL8812AU
    bool "Realtek RTL8812AU (11ac 2x2 5G USB)"
    depends on HI_32BIT_SYSTEM && (HI3798CV200 || HI3798MV200 || HI3798MV300 || HI3798MV300H || HI3798MV310 || HI3796MV200 || HI3716MV450)

config  HI_WIFI_DEVICE_RTL8723BU
    bool "Realtek RTL8723BU (11n 1x1 2.4G USB + BT4.0)"
    depends on HI_32BIT_SYSTEM && (HI3798CV200 || HI3798MV200 || HI3798MV300 || HI3798MV300H || HI3798MV310 || HI3796MV200 || HI3716MV450)

config  HI_WIFI_DEVICE_RTL8822BU
    bool "Realtek RTL8822BU (11ac 2x2 5G USB)"
    depends on HI_32BIT_SYSTEM && (HI3798CV200 || HI3798MV200 || HI3798MV300 || HI3798MV300H || HI3798MV310 || HI3796MV200 || HI3716MV450)

config  HI_WIFI_DEVICE_RTL8821AU
    bool "Realtek RTL8821AU (11ac 1x1 5G USB + BT4.0)"
    depends on HI_32BIT_SYSTEM && HI3798CV200

config  HI_WIFI_DEVICE_MT76X2U
    bool "Mediatek MT7662TU and MT7632TU (2x2 USB + BT4.0)"
    depends on HI_32BIT_SYSTEM && (HI3798MV100 || HI3796MV100 || HI3798CV200 || HI3798MV200 || HI3798MV300 || HI3798MV300H || HI3798MV310 || HI3796MV200 || HI3716MV450)

config  HI_WIFI_DEVICE_MT7662TE
    bool "Mediatek MT7662TE (11ac 2x2 5G PCIE + BT4.0)"
    depends on HI_32BIT_SYSTEM && (HI3798CV200 || HI3798MV200 || HI3798MV300 || HI3798MV300H || HI3798MV310 || HI3796MV200 || HI3716MV450)

config  HI_WIFI_DEVICE_RTL8822BEH
    bool "Realtek RTL8822BEH (11ac 2x2 2.4G+5G PCIE, BT UART)"
    depends on HI_32BIT_SYSTEM && (HI3798CV200 || HI3798MV200 || HI3798MV300 || HI3798MV300H || HI3798MV310 || HI3796MV200 || HI3716MV450)

config  HI_WIFI_DEVICE_QCA6174
    bool "QUALCOM  QCA6174 (11ac 2x2 2.4G+5G PCIE, BT UART)"
    depends on HI_32BIT_SYSTEM && (HI3798MV200 || HI3796MV200 || HI3716MV450)

endmenu

menu    "WiFi Working Mode"
    depends on HI_WIFI_SUPPORT

config  HI_WIFI_MODE_STA
    bool "STA Mode"
    help
        work as STAtion(client)

config  HI_WIFI_MODE_AP
    bool "SoftAP Mode"
    help
        work as Access Point(AP)

endmenu
```
